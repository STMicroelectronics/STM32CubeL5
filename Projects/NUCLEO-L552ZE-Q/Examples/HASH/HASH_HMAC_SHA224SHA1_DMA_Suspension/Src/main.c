/* USER CODE BEGIN Header */
/**
  ******************************************************************************
  * @file           : main.c
  * @brief          : Main program body
  ******************************************************************************
  * @attention
  *
  * <h2><center>&copy; Copyright (c) 2019 STMicroelectronics.
  * All rights reserved.</center></h2>
  *
  * This software component is licensed by ST under BSD 3-Clause license,
  * the "License"; You may not use this file except in compliance with the
  * License. You may obtain a copy of the License at:
  *                        opensource.org/licenses/BSD-3-Clause
  *
  ******************************************************************************
  */
/* USER CODE END Header */
/* Includes ------------------------------------------------------------------*/
#include "main.h"

/* Private includes ----------------------------------------------------------*/
/* USER CODE BEGIN Includes */

/* USER CODE END Includes */

/* Private typedef -----------------------------------------------------------*/
/* USER CODE BEGIN PTD */
typedef enum
{
  HMAC_FIRST_BUFFER        = 0,
  HMAC_INTERMEDIATE_BUFFER = 1,
  HMAC_LAST_BUFFER         = 2,
  HMAC_DIGEST_RETRIEVAL    = 3
} HMAC_MultiBuffer_StepTypeDef;
/* USER CODE END PTD */

/* Private define ------------------------------------------------------------*/
/* USER CODE BEGIN PD */
#define HMAC_MULTIBUFFERS_FUNCTIONS_NUMBER    4          /* Number of APIs to carry HMAC SHA224 processing */
#define LOW_PRIO_LARGE_INPUT_TAB_SIZE  ((uint32_t) 3567) /* The size of the input data "aInput_LowPrio_Large" */
#define HIGH_PRIO_INPUT_TAB_SIZE   ((uint32_t) 261)      /* The size of the input data "aInput_HighPrio" */

#define HASHTimeout        0xFF

#define SHA224_DIGEST_LENGTH 28
#define SHA1_DIGEST_LENGTH   20
/* USER CODE END PD */

/* Private macro -------------------------------------------------------------*/
/* USER CODE BEGIN PM */

/* USER CODE END PM */

/* Private variables ---------------------------------------------------------*/
HASH_HandleTypeDef hhash;
__ALIGN_BEGIN static const uint8_t pKeyHASH[3633] __ALIGN_END = {
                            0x54,0x68,0x65,0x20,0x48,0x41,0x53,0x48,0x20,0x73,
                            0x65,0x71,0x75,0x65,0x6e,0x74,0x69,0x61,0x6c,0x6c,
                            0x79,0x20,0x70,0x72,0x6f,0x63,0x65,0x73,0x73,0x65,
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                            0x20,0x31,0x2e};
DMA_HandleTypeDef hdma_hash_in;

/* USER CODE BEGIN PV */
__ALIGN_BEGIN uint8_t pKeySmall[261] __ALIGN_END =
                        {0x54,0x68,0x65,0x20,0x68,0x61,0x73,0x68,
                         0x20,0x70,0x72,0x6f,0x63,0x65,0x73,0x73,
                         0x6f,0x72,0x20,0x69,0x73,0x20,0x61,0x20,
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                         0x32,0x20,0x2a,0x2a,0x2a};

__ALIGN_BEGIN uint8_t aInput_LowPrio_Large[LOW_PRIO_LARGE_INPUT_TAB_SIZE] __ALIGN_END =
                        {0x54, 0x68, 0x65, 0x20, 0x68, 0x61, 0x73, 0x68, 0x20, 0x70, 0x72, 0x6f, 0x63, 0x65, 0x73, 0x73, 0x6f, 0x72, 0x20, 0x69,
                         0x73, 0x20, 0x61, 0x20, 0x66, 0x75, 0x6c, 0x6c, 0x79, 0x20, 0x63, 0x6f, 0x6d, 0x70, 0x6c, 0x69, 0x61, 0x6e, 0x74, 0x20,
                         0x69, 0x6d, 0x70, 0x6c, 0x65, 0x6d, 0x65, 0x6e, 0x74, 0x61, 0x74, 0x69, 0x6f, 0x6e, 0x20, 0x6f, 0x66, 0x20, 0x74, 0x68,
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                         0x53, 0x48, 0x5f, 0x43, 0x52, 0x29, 0x2e};

__ALIGN_BEGIN uint8_t aInput_HighPrio[HIGH_PRIO_INPUT_TAB_SIZE] __ALIGN_END =
                        {0x54,0x68,0x65,0x20,0x68,0x61,0x73,0x68,
                         0x20,0x70,0x72,0x6f,0x63,0x65,0x73,0x73,
                         0x6f,0x72,0x20,0x69,0x73,0x20,0x61,0x20,
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                         0x32,0x20,0x2a,0x2a,0x2a};

__ALIGN_BEGIN	static uint8_t aSHA224Digest[SHA224_DIGEST_LENGTH] __ALIGN_END;

__ALIGN_BEGIN static uint8_t aExpectSHA224Digest[SHA224_DIGEST_LENGTH] __ALIGN_END =
{
0x4a, 0x6e, 0x86, 0xfc, 0x85, 0xdc, 0xe5, 0x35, 0xc6, 0x05, 0xe6, 0xbd, 0x9c, 0xda, 0x23,
0xbb, 0xc5, 0xc8, 0x96, 0xf8, 0x85, 0xd1, 0x22, 0x4d, 0x74, 0x60, 0xcd, 0x83
};

__ALIGN_BEGIN	static uint8_t aSHA1Digest[SHA1_DIGEST_LENGTH] __ALIGN_END;

__ALIGN_BEGIN static uint8_t aExpectSHA1Digest[SHA1_DIGEST_LENGTH] __ALIGN_END =  {0x2b, 0x47, 0xef, 0x34, 0xf6, 0x66, 0x58, 0xbe, 0x3b,
                              0x2a, 0xc6, 0xec, 0x58, 0x85, 0xf2, 0x1e, 0xd5, 0x9f, 0xdd, 0xad};

uint8_t Storage_Buffer[57 * 4] = {0}; /* 57 32-bit words are saved               */

HASH_HandleTypeDef HashHandle_saved;  /* Handle to store low priority block
                                         HASH parameters during suspension       */
/* USER CODE END PV */

/* Private function prototypes -----------------------------------------------*/
void SystemClock_Config(void);
static void MX_DMA_Init(void);
static void MX_ICACHE_Init(void);
static void MX_HASH_Init(void);
/* USER CODE BEGIN PFP */
static void HigherPriorityBlock_Management(void);
static void HigherPriorityBlock_DMA_Processing(void);
/* Array of functions used for multi-buffer HMAC SHA-224 processing */
HAL_StatusTypeDef (*HMAC_SHA224_MultiBuffer_Functions[HMAC_MULTIBUFFERS_FUNCTIONS_NUMBER]) (HASH_HandleTypeDef *hhash, uint8_t *pBuffer, uint32_t Var) =
                      {HAL_HMACEx_SHA224_Step1_2_DMA,
                       HAL_HMACEx_SHA224_Step2_DMA,
                       HAL_HMACEx_SHA224_Step2_3_DMA,
                       HAL_HASHEx_SHA224_Finish};
/* USER CODE END PFP */

/* Private user code ---------------------------------------------------------*/
/* USER CODE BEGIN 0 */

/* USER CODE END 0 */

/**
  * @brief  The application entry point.
  * @retval int
  */
int main(void)
{
  /* USER CODE BEGIN 1 */
  uint32_t process_ongoing = 1;     /* HMAC processing on-going flag                          */
  uint32_t suspension_trigger = 1;  /* Low block processing suspension trigger                */
  uint32_t iteration_counter = 0;   /* Iteration counter for multi-buffer HMAC processing     */
  uint32_t block_length = 0;        /* Contains block length for multi-buffer HMAC processing */
  uint32_t step = 0;                /* Multi-buffer HMAC processing step counter              */
  uint8_t * input_data = NULL;      /* Pointer at input data                                  */
  /* USER CODE END 1 */

  /* MCU Configuration--------------------------------------------------------*/

  /* Reset of all peripherals, Initializes the Flash interface and the Systick. */
  HAL_Init();

  /* USER CODE BEGIN Init */

  /* USER CODE END Init */

  /* Configure the system clock */
  SystemClock_Config();

  /* USER CODE BEGIN SysInit */
  /* Configure LEDs */
  BSP_LED_Init(LED_GREEN);
  BSP_LED_Init(LED_RED);
  /* USER CODE END SysInit */

  /* Initialize all configured peripherals */
  MX_DMA_Init();
  MX_ICACHE_Init();
  MX_HASH_Init();
  /* USER CODE BEGIN 2 */
  /****************************************************************************/
  /*                                                                          */
  /*       DMA-based HMAC SHA-224 processing suspension/resumption            */
  /*                                                                          */
  /****************************************************************************/
  process_ongoing = 1;      /* Flag indicating a block processing is on-going     */
  iteration_counter = 1;    /* Number of iterations (number of blocks processed ) */
  block_length = 1200;      /* Process the input data as a sequence of smaller blocks
                               each of size 1200 bytes, (except the last one that
                               may be smaller).
                               This is used only to demonstrate the multi-buffer
                               HMAC suspension mechanism. */
  step = HMAC_FIRST_BUFFER; /* Step variable is set to process the first block */

  input_data = aInput_LowPrio_Large;  /* input_data points at the beginning of the input buffer */

  /********************************************************************/
  /*                                                                  */
  /* Start multi-buffer HMAC SHA-224 processing of low priority block */
  /*                                                                  */
  /********************************************************************/
  do
  {
    /* For each step, at first call or to resume processing after suspension, the API is invoked with
       the same handle and same parameters */
    if ((*HMAC_SHA224_MultiBuffer_Functions[step])(&hhash, input_data, block_length) != HAL_OK)
    {
      Error_Handler();
    }

    /**********************************************************************/
    /* While the HASH process in on-going, a suspension request occurs
      (it may be triggered by an interruption in user code). In this example,
      the suspension request is triggered by the flag suspension_trigger  */
    /**********************************************************************/
    if (suspension_trigger == 1)
    {
      suspension_trigger = 0;  /* In this example, for demonstration purposes, each
                                  block processing is suspended only once */

      /* Request DMA-based low priority block processing suspension */
      if (HAL_HASH_DMAFeed_ProcessSuspend(&hhash) != HAL_OK)
      {
          Error_Handler();
      }
    }

    /*************************************************************************/
    /* Wait for low-priority block processing to stop, either upon a process
       suspension or when the low-priority block processing is over          */
    /*************************************************************************/
    while ((HAL_HASH_GetState(&hhash) != HAL_HASH_STATE_SUSPENDED)
           && (HAL_HASH_GetState(&hhash) != HAL_HASH_STATE_READY));

    /**********************************************************/
    /* Check the low-priority block processing stop condition */
    /**********************************************************/
    if (HAL_HASH_GetState(&hhash) == HAL_HASH_STATE_READY)
    {
      /* The block processing is over, move to next block. */
      /* Wait for DMA state to be back to Ready first */
      while (HAL_DMA_GetState(hhash.hdmain) != HAL_DMA_STATE_READY);

      switch (step)
      {
        case HMAC_FIRST_BUFFER:
          /* First block has been processed, move to the next */
          step = HMAC_INTERMEDIATE_BUFFER;
          /* Fall through ... */

        case HMAC_INTERMEDIATE_BUFFER:

          input_data += block_length;  /* Make input_data point at the next block to process */
          iteration_counter++;         /* Increment the iteration (number of processed blocks) counter */

          /* Check whether the last block to process has been reached */
          if (block_length * iteration_counter >= LOW_PRIO_LARGE_INPUT_TAB_SIZE)
          {
             /* The last block has been reached, update step */
             step = HMAC_LAST_BUFFER;
             block_length -=  (block_length * iteration_counter - LOW_PRIO_LARGE_INPUT_TAB_SIZE);
          }

          /* For demonstration purposes, allow the next (low-priority) block
             processing to be suspended */
          suspension_trigger = 1;
          break;

        case HMAC_LAST_BUFFER:
          /* The last buffer has been processed. Mark the end of processing. */
          process_ongoing = 0;
          /* Update step to carry out digest retrieval next */
          step =  HMAC_DIGEST_RETRIEVAL;
          break;

        default:
          Error_Handler();
          break;
      }
    }
    else if (HAL_HASH_GetState(&hhash) == HAL_HASH_STATE_SUSPENDED)
    {
      /* The low-priority block processing is suspended, initiate
         the high-priority block processing */
      HigherPriorityBlock_Management();
      /* Next, low-priority block processing will be resumed in the do{} while() loop
        in re-invoking (*HMAC_SHA224_MultiBuffer_Functions[step])() */
    }
    else
    {
      /* State is neither READY nor SUSPENDED: an error has occurred */
      Error_Handler();
    }

  /******************************************************************************/
  /* Exit the do{} while() loop when the low-priority data full processing is over */
  /******************************************************************************/
  } while (process_ongoing);


  /*******************/
  /* Read the digest */
  /*******************/
  if ((*HMAC_SHA224_MultiBuffer_Functions[step])(&hhash, aSHA224Digest, HASHTimeout) != HAL_OK)
  {
    Error_Handler();
  }

  if(memcmp(aSHA224Digest, aExpectSHA224Digest, SHA224_DIGEST_LENGTH) != 0)
  {
    Error_Handler();
  }
  else
  {
    BSP_LED_On(LED_GREEN);
  }
  /* USER CODE END 2 */

  /* Infinite loop */
  /* USER CODE BEGIN WHILE */
  while (1)
  {
    /* USER CODE END WHILE */

    /* USER CODE BEGIN 3 */
  }
  /* USER CODE END 3 */
}

/**
  * @brief System Clock Configuration
  * @retval None
  */
void SystemClock_Config(void)
{
  RCC_OscInitTypeDef RCC_OscInitStruct = {0};
  RCC_ClkInitTypeDef RCC_ClkInitStruct = {0};

  /** Configure the main internal regulator output voltage
  */
  if (HAL_PWREx_ControlVoltageScaling(PWR_REGULATOR_VOLTAGE_SCALE0) != HAL_OK)
  {
    Error_Handler();
  }
  /** Initializes the RCC Oscillators according to the specified parameters
  * in the RCC_OscInitTypeDef structure.
  */
  RCC_OscInitStruct.OscillatorType = RCC_OSCILLATORTYPE_MSI;
  RCC_OscInitStruct.MSIState = RCC_MSI_ON;
  RCC_OscInitStruct.MSICalibrationValue = RCC_MSICALIBRATION_DEFAULT;
  RCC_OscInitStruct.MSIClockRange = RCC_MSIRANGE_6;
  RCC_OscInitStruct.PLL.PLLState = RCC_PLL_ON;
  RCC_OscInitStruct.PLL.PLLSource = RCC_PLLSOURCE_MSI;
  RCC_OscInitStruct.PLL.PLLM = 1;
  RCC_OscInitStruct.PLL.PLLN = 55;
  RCC_OscInitStruct.PLL.PLLP = RCC_PLLP_DIV7;
  RCC_OscInitStruct.PLL.PLLQ = RCC_PLLQ_DIV2;
  RCC_OscInitStruct.PLL.PLLR = RCC_PLLR_DIV2;
  if (HAL_RCC_OscConfig(&RCC_OscInitStruct) != HAL_OK)
  {
    Error_Handler();
  }
  /** Initializes the CPU, AHB and APB buses clocks
  */
  RCC_ClkInitStruct.ClockType = RCC_CLOCKTYPE_HCLK|RCC_CLOCKTYPE_SYSCLK
                              |RCC_CLOCKTYPE_PCLK1|RCC_CLOCKTYPE_PCLK2;
  RCC_ClkInitStruct.SYSCLKSource = RCC_SYSCLKSOURCE_PLLCLK;
  RCC_ClkInitStruct.AHBCLKDivider = RCC_SYSCLK_DIV1;
  RCC_ClkInitStruct.APB1CLKDivider = RCC_HCLK_DIV1;
  RCC_ClkInitStruct.APB2CLKDivider = RCC_HCLK_DIV1;

  if (HAL_RCC_ClockConfig(&RCC_ClkInitStruct, FLASH_LATENCY_5) != HAL_OK)
  {
    Error_Handler();
  }
}

/**
  * @brief HASH Initialization Function
  * @param None
  * @retval None
  */
static void MX_HASH_Init(void)
{

  /* USER CODE BEGIN HASH_Init 0 */

  /* USER CODE END HASH_Init 0 */

  /* USER CODE BEGIN HASH_Init 1 */

  /* USER CODE END HASH_Init 1 */
  hhash.Init.DataType = HASH_DATATYPE_8B;
  hhash.Init.KeySize = 3633;
  hhash.Init.pKey = (uint8_t *)pKeyHASH;
  if (HAL_HASH_Init(&hhash) != HAL_OK)
  {
    Error_Handler();
  }
  /* USER CODE BEGIN HASH_Init 2 */

  /* USER CODE END HASH_Init 2 */

}

/**
  * @brief ICACHE Initialization Function
  * @param None
  * @retval None
  */
static void MX_ICACHE_Init(void)
{

  /* USER CODE BEGIN ICACHE_Init 0 */

  /* USER CODE END ICACHE_Init 0 */

  /* USER CODE BEGIN ICACHE_Init 1 */

  /* USER CODE END ICACHE_Init 1 */
  /** Enable instruction cache in 1-way (direct mapped cache)
  */
  if (HAL_ICACHE_ConfigAssociativityMode(ICACHE_1WAY) != HAL_OK)
  {
    Error_Handler();
  }
  if (HAL_ICACHE_Enable() != HAL_OK)
  {
    Error_Handler();
  }
  /* USER CODE BEGIN ICACHE_Init 2 */

  /* USER CODE END ICACHE_Init 2 */

}

/**
  * Enable DMA controller clock
  */
static void MX_DMA_Init(void)
{

  /* DMA controller clock enable */
  __HAL_RCC_DMAMUX1_CLK_ENABLE();
  __HAL_RCC_DMA2_CLK_ENABLE();

  /* DMA interrupt init */
  /* DMA2_Channel7_IRQn interrupt configuration */
  HAL_NVIC_SetPriority(DMA2_Channel7_IRQn, 7, 0);
  HAL_NVIC_EnableIRQ(DMA2_Channel7_IRQn);

}

/* USER CODE BEGIN 4 */
/**
  * @brief Once low priority block HMAC SHA-224 processing is suspended, save the HASH
  *        context, computes then checks the high priority block digest and finally
  *        restores the low priority block context.
  *        In the example at hand, the high priority block processing is HMAC SHA-1
  *        where data are fed to the IP in DMA mode.
  * @param  None
  * @retval None
  */
static void HigherPriorityBlock_Management(void)
{
      /* Context saving operation */
      HAL_HASH_ContextSaving(&hhash, Storage_Buffer);
      /* Save low-priority block HASH handle parameters */
      HashHandle_saved = hhash;

      /* Compute HMAC SHA-1 digest for the high priority block */
      HigherPriorityBlock_DMA_Processing();
      /* Check the computed result */
      if (memcmp(aSHA1Digest, aExpectSHA1Digest, SHA1_DIGEST_LENGTH) != 0)
      {
        Error_Handler();
      }

      /* Context restoring operation */
      HAL_HASH_ContextRestoring(&hhash, Storage_Buffer);
      hhash = HashHandle_saved;
}

/**
  * @brief Computes high priority block HMAC SHA-1 digest.
  * @param  None
  * @retval None
  */
static void HigherPriorityBlock_DMA_Processing(void)
{

  /* HashHandle has been saved previously in HashHandle_saved.
     For the high priority block, all the initialization parameters are the
     same but the key */
  hhash.Init.pKey = (uint8_t *)pKeySmall;
  hhash.Init.KeySize = 261;
  if (HAL_HASH_Init(&hhash) != HAL_OK)
  {
    Error_Handler();
  }

  /* Computes HMAC SHA-1 digest */
  if (HAL_HMAC_SHA1_Start_DMA(&hhash, aInput_HighPrio, HIGH_PRIO_INPUT_TAB_SIZE) != HAL_OK)
  {
    Error_Handler();
  }
  /* Wait until processing is over */
  while (HAL_HASH_GetState(&hhash) == HAL_HASH_STATE_BUSY);

  /* Read digest */
  if (HAL_HASH_SHA1_Finish(&hhash, aSHA1Digest, HASHTimeout) != HAL_OK)
  {
    Error_Handler();
  }


  return;
}
/* USER CODE END 4 */

/**
  * @brief  This function is executed in case of error occurrence.
  * @retval None
  */
void Error_Handler(void)
{
  /* USER CODE BEGIN Error_Handler_Debug */
  /* Turn LED_RED on */
  BSP_LED_On(LED_RED);
  while (1)
  {
  }
  /* USER CODE END Error_Handler_Debug */
}

#ifdef  USE_FULL_ASSERT
/**
  * @brief  Reports the name of the source file and the source line number
  *         where the assert_param error has occurred.
  * @param  file: pointer to the source file name
  * @param  line: assert_param error line source number
  * @retval None
  */
void assert_failed(uint8_t *file, uint32_t line)
{
  /* USER CODE BEGIN 6 */
  while (1)
  {
  }
  /* USER CODE END 6 */
}
#endif /* USE_FULL_ASSERT */

/************************ (C) COPYRIGHT STMicroelectronics *****END OF FILE****/
